## examples/uart0-with-console/sdkconfig.defaults.esp32s3
```kconfig
# ESP32-S3 Specific - UART0 Multiplexed Configuration

# Flash Size
CONFIG_ESPTOOLPY_FLASHSIZE_16MB=y
CONFIG_ESPTOOLPY_FLASHSIZE="16MB"

# Partition Table
CONFIG_PARTITION_TABLE_CUSTOM=y
CONFIG_PARTITION_TABLE_CUSTOM_FILENAME="partitions_16mb.csv"

# Console on UART0 (shared with filebridge)
CONFIG_ESP_CONSOLE_UART_NUM=0
CONFIG_ESP_CONSOLE_UART_BAUDRATE=115200

# UART Filebridge - UART0 Configuration  
CONFIG_UART_FILEBRIDGE_NUM=0
CONFIG_UART_FILEBRIDGE_TX_PIN=43
CONFIG_UART_FILEBRIDGE_RX_PIN=44
CONFIG_UART_FILEBRIDGE_RTS_PIN=-1
CONFIG_UART_FILEBRIDGE_CTS_PIN=-1
CONFIG_UART_FILEBRIDGE_BAUD=115200
CONFIG_UART_FILEBRIDGE_RX_BUF_SIZE=16384
CONFIG_UART_FILEBRIDGE_TX_BUF_SIZE=16384

# Storage Backends
CONFIG_UART_FILEBRIDGE_SD_MOUNT_OWN=n

CONFIG_UART_FILEBRIDGE_BACKEND_SPIFFS=y
CONFIG_UART_FILEBRIDGE_SPIFFS_MOUNT_POINT="/spiffs"
CONFIG_UART_FILEBRIDGE_SPIFFS_PARTITION="spiffs"
CONFIG_UART_FILEBRIDGE_SPIFFS_MAX_FILES=5

CONFIG_UART_FILEBRIDGE_BACKEND_FLASH_FAT=y
CONFIG_UART_FILEBRIDGE_FLASH_FAT_MOUNT_POINT="/flash"
CONFIG_UART_FILEBRIDGE_FLASH_FAT_PARTITION="flash"
CONFIG_UART_FILEBRIDGE_FLASH_FAT_MAX_FILES=5

CONFIG_UART_FILEBRIDGE_BACKEND_LITTLEFS=y
CONFIG_UART_FILEBRIDGE_LITTLEFS_MOUNT_POINT="/lfs"
CONFIG_UART_FILEBRIDGE_LITTLEFS_PARTITION="littlefs"
CONFIG_UART_FILEBRIDGE_LITTLEFS_MAX_FILES=5

# Performance
CONFIG_COMPILER_OPTIMIZATION_PERF=y
CONFIG_FREERTOS_UNICORE=n
CONFIG_ESP_DEFAULT_CPU_FREQ_MHZ_240=y
```
